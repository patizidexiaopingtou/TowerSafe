## device/board/LeeTai/TowerSafe/Kconfig.liteos_m.board
```kconfig
menuconfig BOARD_TOWERSAFE
    bool "select board TowerSafe"
    depends on SOC_ESP32_D0WDQ6

if BOARD_TOWERSAFE

menuconfig ENABLE_LVGL
    bool "enalbe lvgl"
    depends on BOARD_TOWERSAFE

orsource "../../../../vendor/LeeTai/TowerSafe/app/Kconfig.liteos_m.applications"
#orsource "../../../../vendor/LeeTai/demo/Kconfig.liteos_m.applications"

endif #BOARD_TOWERSAFE
```

## device/soc/esp/esp32/Kconfig.liteos_m.defconfig.series
```kconfig
if SOC_SERIES_ESP32

rsource "Kconfig.liteos_m.defconfig.esp32_u4wdh"
rsource "Kconfig.liteos_m.defconfig.esp32_d0wdq6"
rsource "Kconfig.liteos_m.defconfig.esp32_pico"
rsource "Kconfig.liteos_m.defconfig.esp32_s3"
config SOC_SERIES
    string
    default "esp32_d0wdq6"

endif
```

## device/soc/esp/esp32/Kconfig.liteos_m.series
```kconfig
config SOC_SERIES_ESP32
    bool "Espressif Series"
    select XTENSA
    select SOC_COMPANY_ESPRESSIF
    select CPU_LX6
    help
        Enable support for esp32 series
```

## device/soc/esp/esp32/Kconfig.liteos_m.soc
```kconfig
# Copyright (c) 2022 Hunan OpenValley Digital Industry Development Co., Ltd.
# Licensed under the Apache License, Version 2.0 (the "License");
# you may not use this file except in compliance with the License.
# You may obtain a copy of the License at
#
#     http://www.apache.org/licenses/LICENSE-2.0
#
# Unless required by applicable law or agreed to in writing, software
# distributed under the License is distributed on an "AS IS" BASIS,
# WITHOUT WARRANTIES OR CONDITIONS OF ANY KIND, either express or implied.
# See the License for the specific language governing permissions and
# limitations under the License.

config SOC_ESP32_U4WDH
    bool "SoC ESP32-U4WDH"

config SOC_ESP32_D0WDQ6
    bool "SoC ESP32-D0WDQ6"

config SOC_ESP32_PICO
    bool "SoC ESP32-PICO"

config SOC_ESP32_S3
    bool "SoC ESP32-S3"
```

## vendor/LeeTai/TowerSafe/app/Kconfig.liteos_m.applications
```kconfig
config USE_DIEMIT_APPLICATION
    bool "use diemit TowerSafe application"
    default n
    help
        This is a switch for use diemit TowerSafe application.
        If you want to write your application code, please close it.

choice
        prompt "TowerSafe application choose"
        depends on USE_DIEMIT_APPLICATION
        default TowerSafe_APPLICATION_001
        help
            This is a choose for application name
        orsource "*/.application_config"
endchoice

config DIEMIT_APPLICATION_NAME
    string
    depends on USE_DIEMIT_APPLICATION
    default "base_power" if TOWERSAFE_APPLICATION_001
    default "base_rtc" if TOWERSAFE_APPLICATION_002
    default "base_display" if TOWERSAFE_APPLICATION_005
    default "base_lvgl" if TOWERSAFE_APPLICATION_006
    default "weather_app" if TOWERSAFE_APPLICATION_009
    default "dpet" if TOWERSAFE_APPLICATION_010
    default "101_hdf_adc" if TOWERSAFE_APPLICATION_101
    default "102_hdf_gpio" if TOWERSAFE_APPLICATION_102
    default "106_hdf_i2c" if TOWERSAFE_APPLICATION_106
    default "count_down_app" if TOWERSAFE_APPLICATION_088
    default "004_system_los_event" if TOWERSAFE_APPLICATION_004
    default "irrigation_system_app" if TOWERSAFE_APPLICATION_089
```
